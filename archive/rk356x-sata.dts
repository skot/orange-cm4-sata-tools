/dts-v1/;
/plugin/;

/ {
	compatible = "rockchip,rk3566-orangepi-cm4", "rockchip,rk3566";

	fragment@0 {
		target-path = "/sata@fc400000";
		__overlay__ {
			status = "okay";
		};
	};

	fragment@1 {
		target-path = "/sata@fc800000";
		__overlay__ {
			status = "okay";
		};
	};

	fragment@2 {
		target-path = "/pcie@fe260000";
		__overlay__ {
			status = "disabled";
		};
	};
};
